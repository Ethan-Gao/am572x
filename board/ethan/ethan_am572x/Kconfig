## board/ethan/ethan_am572x/Kconfig
```kconfig
if TARGET_ETHAN_AM572X

config SYS_BOARD
	default "ethan_am572x"

config SYS_VENDOR
	default "ethan"

config SYS_CONFIG_NAME
	default "ethan_am572x"

config CONS_INDEX
        int "UART used for console"
        range 1 6
        default 3
        help
          The AM57x (and DRA7xx) SoC has a total of 6 UARTs available to it.
          Depending on your specific board you may want something other than UART3
          here.

source "board/ethan/common/Kconfig"

endif
```
